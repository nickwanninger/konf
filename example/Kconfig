## example/Kconfig
```kconfig
mainmenu "Example Configuration"

menu "Build"

	config GCC
		bool "Use GCC"
		default y

	config CLANG
		bool "Use Clang"
		default n

	config DEBUG
		bool "Enable Debug"
		default n

	config OPTIMIZATION
		bool "Enable Optimization"
		default y

endmenu
```
